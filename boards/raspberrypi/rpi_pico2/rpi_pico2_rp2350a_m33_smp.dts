/*
 * Copyright (c) 2026 Muhammad Waleed Badar
 * SPDX-License-Identifier: Apache-2.0
 */

/* The Pico 2 board in the Zephyr tree, which this directory extends. */
#include <../boards/raspberrypi/rpi_pico2/rpi_pico2_rp2350a_m33_0.dts>

/*
 * SysTick is per core, so the system timer is TIMER1, which both cores see.
 * TIMER0 is left to the counter driver.
 */
&systick {
	status = "disabled";
};

&timer1 {
	compatible = "raspberrypi,pico-system-timer";
	status = "okay";
};
