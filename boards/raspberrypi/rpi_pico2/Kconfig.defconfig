## boards/raspberrypi/rpi_pico2/board.yml
```yaml
# Copyright (c) 2026 Muhammad Waleed Badar
# SPDX-License-Identifier: Apache-2.0

board:
  extend: rpi_pico2
  variants:
    - name: smp
      qualifier: rp2350a/m33
```

## boards/raspberrypi/rpi_pico2/rpi_pico2_rp2350a_m33_smp_defconfig
```kconfig
# Copyright (c) 2026 Muhammad Waleed Badar
# SPDX-License-Identifier: Apache-2.0

# What the Pico 2 has without SMP
CONFIG_BUILD_OUTPUT_HEX=y
CONFIG_BUILD_OUTPUT_UF2=y
CONFIG_CLOCK_CONTROL=y
CONFIG_CONSOLE=y
CONFIG_GPIO=y
CONFIG_RESET=y
CONFIG_SERIAL=y
CONFIG_UART_CONSOLE=y
CONFIG_UART_INTERRUPT_DRIVEN=y
CONFIG_USE_DT_CODE_PARTITION=y

# One kernel on both cores
CONFIG_SMP=y
CONFIG_MP_MAX_NUM_CPUS=2
```

## boards/renode/cortex_m33/board.yml
```yaml
board:
  name: cortex_m33
  full_name: RP2350 in Renode
  vendor: renode
  socs:
    - name: rp2350a
      variants:
        - name: smp
          cpucluster: m33
```

## boards/renode/cortex_m33/cortex_m33_m33_0_defconfig
```kconfig
# Copyright (c) 2026 Muhammad Waleed Badar
# SPDX-License-Identifier: Apache-2.0

CONFIG_CLOCK_CONTROL=y
CONFIG_CONSOLE=y
CONFIG_GPIO=y
CONFIG_RESET=y
CONFIG_SERIAL=y
CONFIG_UART_CONSOLE=y
CONFIG_UART_INTERRUPT_DRIVEN=y
CONFIG_USE_DT_CODE_PARTITION=y
```

## soc/rp2350/Kconfig
```kconfig
# Copyright (c) 2026 Muhammad Waleed Badar
# SPDX-License-Identifier: Apache-2.0

config RP2350_SMP
	bool
	default y
	depends on SOC_SERIES_RP2350 && CPU_CORTEX_M33
	depends on SMP || MP_MAX_NUM_CPUS > 1
	select SOC_PER_CORE_INIT_HOOK
	select SCHED_IPI_SUPPORTED if SMP
	select ARCH_HAS_DIRECTED_IPIS if SMP
```

## tests/multicore/testcase.yaml
```yaml
common:
  tags: renode
  platform_allow:
    - cortex_m33/rp2350a/m33_0
  integration_platforms:
    - cortex_m33/rp2350a/m33_0
tests:
  renode_rp2350.multicore:
    harness: robot
    harness_config:
      robot_testsuite: multicore.robot
```

## tests/peripherals/testcase.yaml
```yaml
common:
  tags: renode
  platform_allow:
    - cortex_m33/rp2350a/m33_0
  integration_platforms:
    - cortex_m33/rp2350a/m33_0
tests:
  renode_rp2350.peripherals:
    harness: robot
    harness_config:
      robot_testsuite: peripherals.robot
```

## zephyr/Kconfig
```kconfig
# Copyright (c) 2026 Muhammad Waleed Badar
# SPDX-License-Identifier: Apache-2.0

rsource "../soc/rp2350/Kconfig"
rsource "../drivers/timer/Kconfig"
```
