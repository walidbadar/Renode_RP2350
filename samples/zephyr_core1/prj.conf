## CMakeLists.txt
```
# Copyright (c) 2026 Muhammad Waleed Badar
# SPDX-License-Identifier: Apache-2.0

cmake_minimum_required(VERSION 3.20.0)

find_package(Zephyr REQUIRED HINTS $ENV{ZEPHYR_BASE})
project(zephyr_core1)

target_sources(app PRIVATE src/main.c src/core1.c)
```

## sample.yaml
```
sample:
  name: Zephyr with a worker on core 1 of the RP2350
tests:
  sample.renode_rp2350.zephyr_core1:
    tags: mbox
    platform_allow:
      - cortex_m33/rp2350a/m33_0
      - rpi_pico2/rp2350a/m33_0
    integration_platforms:
      - cortex_m33/rp2350a/m33_0
    harness: console
    harness_config:
      type: one_line
      regex:
        - "core 1 answered 5 of 5 requests"
```

## prj.conf
```kconfig
# Copyright (c) 2026 Muhammad Waleed Badar
# SPDX-License-Identifier: Apache-2.0

CONFIG_MBOX=y
```

## app.overlay
```dts
/*
 * Copyright (c) 2026 Muhammad Waleed Badar
 * SPDX-License-Identifier: Apache-2.0
 */

&mbox {
	status = "okay";
};
```

## src/main.c
```c
/*
 * Copyright (c) 2026 Muhammad Waleed Badar
 * SPDX-License-Identifier: Apache-2.0
 *
 * Zephyr on core 0 launches a worker on core 1 and hands it numbers to square
 * through the driver for the inter-core mailbox.
 */

#include <zephyr/device.h>
#include <zephyr/drivers/mbox.h>
#include <zephyr/kernel.h>

#include <hardware/structs/sio.h>

#include "core1.h"

#define REQUESTS	5

static K_SEM_DEFINE(answered, 0, 1);
static uint32_t answer;

/* Called from the mailbox interrupt on core 0. */
static void received(const struct device *dev, mbox_channel_id_t channel, void *user_data,
		     struct mbox_msg *msg)
{
	ARG_UNUSED(dev);
	ARG_UNUSED(channel);
	ARG_UNUSED(user_data);

	answer = *(const uint32_t *)msg->data;
	k_sem_give(&answered);
}

int main(void)
{
	const struct device *mbox = DEVICE_DT_GET(DT_NODELABEL(mbox));
	unsigned int answers = 0;
	uint32_t hello;

	printk("Zephyr on core %u\n", sio_hw->cpuid);

	if (!core1_launch()) {
		printk("core 1 did not answer the launch sequence\n");
		return 0;
	}

	/* The worker's first word says which core it found itself on. */
	while ((sio_hw->fifo_st & SIO_FIFO_ST_VLD_BITS) == 0) {
	}
	hello = sio_hw->fifo_rd;
	printk("worker on core %u\n", hello & ~CORE1_HELLO);

	mbox_register_callback(mbox, 0, received, NULL);
	mbox_set_enabled(mbox, 0, true);

	for (uint32_t n = 1; n <= REQUESTS; n++) {
		struct mbox_msg msg = { .data = &n, .size = sizeof(n) };

		if (mbox_send(mbox, 0, &msg) != 0 || k_sem_take(&answered, K_MSEC(100)) != 0) {
			printk("no answer for %u\n", n);
			continue;
		}
		printk("%u squared is %u\n", n, answer);
		answers += (answer == n * n);
	}

	printk("core 1 answered %u of %u requests\n", answers, REQUESTS);

	return 0;
}
```

## src/core1.c
```c
/*
 * Copyright (c) 2026 Muhammad Waleed Badar
 * SPDX-License-Identifier: Apache-2.0
 *
 * Launching core 1, and what it runs: a plain function with a stack and a
 * vector table of its own, which calls nothing in the kernel, takes no
 * interrupts and talks to core 0 through the mailbox only.
 */

#include <zephyr/kernel.h>
#include <zephyr/toolchain.h>

#include <cmsis_core.h>
#include <hardware/structs/sio.h>

#include "core1.h"

#define CORE1_STACK_WORDS	256

static uint32_t core1_stack[CORE1_STACK_WORDS];

static void core1_fault(void)
{
	for (;;) {
	}
}

/* Answer every number that arrives with its square. */
static void core1_worker(void)
{
	sio_hw->fifo_wr = CORE1_HELLO | sio_hw->cpuid;
	__SEV();

	for (;;) {
		uint32_t n;

		while ((sio_hw->fifo_st & SIO_FIFO_ST_VLD_BITS) == 0) {
			__WFE();
		}
		n = sio_hw->fifo_rd;

		while ((sio_hw->fifo_st & SIO_FIFO_ST_RDY_BITS) == 0) {
		}
		sio_hw->fifo_wr = n * n;
		__SEV();
	}
}

/*
 * Zephyr's interrupt handling keeps its state per CPU and has only one here,
 * so core 1 gets a vector table of its own: faults stop the core.
 */
static const uint32_t core1_vectors[16] __aligned(256) = {
	(uint32_t)&core1_stack[CORE1_STACK_WORDS],
	(uint32_t)core1_worker,
	[2 ... 15] = (uint32_t)core1_fault,
};

/* Returns false if nothing arrives within the timeout. */
static bool fifo_pop(uint32_t *value, k_timeout_t timeout)
{
	k_timepoint_t end = sys_timepoint_calc(timeout);

	while ((sio_hw->fifo_st & SIO_FIFO_ST_VLD_BITS) == 0) {
		if (sys_timepoint_expired(end)) {
			return false;
		}
	}
	*value = sio_hw->fifo_rd;
	return true;
}

/*
 * The boot ROM holds core 1 until it has been sent, and has echoed, this
 * sequence. Any wrong echo means the two sides are out of step, and the
 * zeroes at the start are there to get them back in step.
 */
bool core1_launch(void)
{
	const uint32_t sequence[] = {
		0, 0, 1,
		(uint32_t)core1_vectors,
		(uint32_t)&core1_stack[CORE1_STACK_WORDS],
		(uint32_t)core1_worker,
	};
	k_timepoint_t end = sys_timepoint_calc(K_MSEC(100));
	unsigned int i = 0;

	while (i < ARRAY_SIZE(sequence)) {
		uint32_t word = sequence[i];
		uint32_t echo;

		if (sys_timepoint_expired(end)) {
			return false;
		}
		if (word == 0) {
			while ((sio_hw->fifo_st & SIO_FIFO_ST_VLD_BITS) != 0) {
				(void)sio_hw->fifo_rd;
			}
			__SEV();
		}
		sio_hw->fifo_wr = word;
		__SEV();
		if (!fifo_pop(&echo, K_MSEC(10))) {
			return false;
		}
		i = (echo == word) ? i + 1 : 0;
	}

	return true;
}
```

## src/core1.h
```c
/*
 * Copyright (c) 2026 Muhammad Waleed Badar
 * SPDX-License-Identifier: Apache-2.0
 */

#ifndef CORE1_H
#define CORE1_H

#include <stdbool.h>
#include <stdint.h>

/* What core 1 sends once it runs, with its CPUID in the low bits. */
#define CORE1_HELLO	0xc0de0000u

/*
 * Take core 1 out of the boot ROM and into the worker. Returns false if the
 * ROM does not answer. Call it before the mailbox driver is enabled: the
 * launch sequence goes over the same FIFO.
 */
bool core1_launch(void);

#endif /* CORE1_H */
```
